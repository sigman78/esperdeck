## components/display/Kconfig.projbuild
```kconfig
menu "display"

    config DISPLAY_ISR_BENCH
        bool "Enable render-ISR per-chunk cycle bench"
        default y
        help
            Accumulates per-chunk cycle counts (avg/max) around
            display_render_chunk. ~20 cycles/chunk overhead — cheap enough
            to leave on. Drain with display_render_bench_get(), then clear
            with display_render_bench_reset().

endmenu
```

## components/input/Kconfig.projbuild
```kconfig
menu "Input HAL"

    choice INPUT_BACKEND
        prompt "Input backend"
        default INPUT_AUTO
        help
            Select which input backend(s) to compile and initialise.
            AUTO enables both BLE HID and USB-Serial-JTAG simultaneously.

        config INPUT_AUTO
            bool "AUTO (BLE HID + USB-Serial-JTAG)"

        config INPUT_BLE
            bool "BLE HID only"

        config INPUT_UART
            bool "USB-Serial-JTAG only"
    endchoice

    config INPUT_BLE_SCAN_DURATION
        int "BLE scan duration (seconds)"
        depends on INPUT_BLE || INPUT_AUTO
        default 10
        range 1 60
        help
            How long each scan window lasts before giving up and waiting
            for the next reconnect attempt.

    config INPUT_TOUCH
        bool "Enable GT911 touch input backend"
        default y

    config INPUT_TOUCH_I2C_PORT
        int "I2C port number for GT911"
        default 0
        depends on INPUT_TOUCH

    config INPUT_TOUCH_SDA_PIN
        int "SDA GPIO pin for GT911"
        default 8
        depends on INPUT_TOUCH

    config INPUT_TOUCH_SCL_PIN
        int "SCL GPIO pin for GT911"
        default 9
        depends on INPUT_TOUCH

    config INPUT_TOUCH_WAVESHARE_RESET
        bool "Enable Waveshare Touch-LCD-7 hardware reset sequence"
        depends on INPUT_TOUCH
        default y
        help
            The Waveshare ESP32-S3-Touch-LCD-7 routes GT911 RST and INT
            through I2C IO expanders (0x24 and 0x38).  Enable to run the
            required reset sequence at startup.  Disable only when using
            a bare GT911 with direct GPIO wiring.

    config INPUT_TOUCH_RESET_GPIO
        int "Board enable GPIO pin for GT911 reset"
        depends on INPUT_TOUCH && INPUT_TOUCH_WAVESHARE_RESET
        default 4
        range 0 48

    config INPUT_TOUCH_SCROLL
        bool "Right-edge drag scrolls the scrollback"
        depends on INPUT_TOUCH && VTERM_SCROLLBACK_LINES != 0
        default y
        help
            Compiles in the edge-drag gesture and its SYSTEM menu toggle.
            A press starting in the right-edge strip and moving vertically
            pages the scrollback instead of producing a tap.

            Pointless without scrollback, hence the dependency: with
            VTERM_SCROLLBACK_LINES at 0 there is nothing to scroll and this
            option disappears.

            The gesture itself is switched on and off from the menu at
            runtime; this only decides whether it exists in the build.

    config INPUT_TOUCH_SCROLL_EDGE_PX
        int "Width of the right-edge scroll strip (pixels)"
        depends on INPUT_TOUCH_SCROLL
        default 48
        range 16 200
        help
            How far in from the right edge a press may start and still be
            taken as a scroll drag. 48 px is about a finger width on the
            7" panel, and six character cells at the 8x16 font.

    config INPUT_TOUCH_SCROLL_SPEED_PCT
        int "Scroll drag speed (percent of 1:1)"
        depends on INPUT_TOUCH_SCROLL
        default 150
        range 25 500
        help
            How far the view moves per unit of finger travel, as a
            percentage. 100 is 1:1 — the text tracks the finger exactly.
            150 (the default) moves half again as fast, which covers more
            of a long buffer without losing the sense of dragging the
            content itself.

            Applied to accumulated pixels, so the fraction is not lost:
            a slow drag still scrolls, it just takes more travel per row.

endmenu
```

## components/vterm/Kconfig.projbuild
```kconfig
menu "vterm"

    config VTERM_SCROLLBACK_LINES
        int "Terminal scrollback lines"
        default 1000
        range 0 4000
        help
            Rows of output kept after they scroll off the top, reachable
            with Shift+PageUp / Shift+PageDown.

            Costs lines * columns * 8 bytes, allocated once at startup and
            preferentially in PSRAM: 1000 lines at 100 columns is 800 KB of
            the ~8.3 MB free there, and none of the internal DRAM the render
            ISR competes for. A request that will not fit is halved until it
            does, so an over-large value shortens history rather than
            failing to boot.

            0 disables scrollback and allocates nothing.

    config VTERM_BENCH
        bool "Enable performance instrumentation"
        default n
        help
            Accumulates cycle counts and byte statistics across flush calls.
            Call vterm_bench_report() to log a summary.
            Zero overhead when disabled.

endmenu
```

## components/wifi/Kconfig.projbuild
```kconfig
menu "SSH import / web manager"

    config SSH_IMPORT_POP_DISABLED
        bool "DEV: disable the web-mode proof code (auto-fill it in the page)"
        default n
        help
            Development convenience for WEB (LAN) import mode: the served
            page embeds the session proof code as a hidden prefilled field,
            so no code entry is needed and the stored-profile list loads
            automatically. ANYONE who can open the page can then read,
            add, edit and delete profiles on the deck.

            SoftAP mode is unaffected (there the code is the WPA2
            passphrase and is still needed to join the AP).

            Never ship a build with this enabled.

endmenu
```

## main/Kconfig.projbuild
```kconfig
menu "Cyberdeck Configuration"

    menu "Terminal font"

    comment "Sizes selectable at runtime (Config > Font, applied on reboot)"

    config CYBERDECK_FONT_RT_8X16
        bool "Terminus 8x16 (100x30 grid)"
        default y
    config CYBERDECK_FONT_RT_10X20
        bool "Terminus 10x20 (80x24 grid)"
        default y
    config CYBERDECK_FONT_RT_12X24
        bool "Terminus 12x24 (66x20 grid)"
        default y

    comment "WARNING: enable at least one font size"
        depends on !CYBERDECK_FONT_RT_8X16 && !CYBERDECK_FONT_RT_10X20 && \
                   !CYBERDECK_FONT_RT_12X24

    choice CYBERDECK_FONT_DEFAULT
        prompt "Font used before one is chosen"
        default CYBERDECK_FONT_DEFAULT_8X16
        help
            Applied on first boot and whenever the stored choice names a size
            that is not enabled above (a setting can outlive a Kconfig
            change). If this size is disabled too, the first enabled one wins.

        config CYBERDECK_FONT_DEFAULT_8X16
            bool "8x16"
        config CYBERDECK_FONT_DEFAULT_10X20
            bool "10x20"
        config CYBERDECK_FONT_DEFAULT_12X24
            bool "12x24"
    endchoice

    endmenu

    config CYBERDECK_FONT_BOLD
        bool "Real bold glyphs (Terminus bold face)"
        default y
        help
            Store the Terminus bold face for ASCII, Latin-1/Extended-A and
            Cyrillic (~6.6 / 16.5 / 19.8 KB internal DRAM at 8x16 / 10x20 /
            12x24). SGR-bold text renders with true bold glyphs; codepoints
            outside the subset fall back to the bold-pop color effect.
            Disable to reclaim the DRAM.

    config SCROLLBACK_LINES
        int "Scrollback buffer (lines)"
        default 1000
        range 0 10000
        help
            Number of lines to keep in scrollback buffer.
            Requires additional PSRAM. Set to 0 to disable.

    config DEFAULT_FG_COLOR
        int "Default foreground color (0-255)"
        default 7
        range 0 255
        help
            Default text foreground color (ANSI 256-color palette).
            7 = white/light gray

    config DEFAULT_BG_COLOR
        int "Default background color (0-255)"
        default 0
        range 0 255
        help
            Default text background color (ANSI 256-color palette).
            0 = black

    config SSH_KEEPALIVE_INTERVAL
        int "SSH keep-alive interval (seconds)"
        default 60
        range 0 300
        help
            Send SSH keep-alive packets every N seconds.
            Set to 0 to disable keep-alive.

    config WIFI_SSID
        string "WiFi SSID"
        default "myssid"
        help
            SSID (network name) for the WiFi connection.

    config WIFI_PASSWORD
        string "WiFi Password"
        default "mypassword"
        help
            WiFi password (WPA or WPA2).

    config SSH_DEFAULT_HOST
        string "Default SSH host"
        default "192.168.1.100"
        help
            Default SSH server hostname or IP address.

    config SSH_DEFAULT_PORT
        int "Default SSH port"
        default 22
        range 1 65535
        help
            Default SSH server port.

    config SSH_DEFAULT_USER
        string "Default SSH username"
        default "user"
        help
            Default SSH username for authentication.

    config SSH_DEFAULT_PASSWORD
        string "Default SSH password"
        default ""
        help
            Default SSH password. Leave empty if using key-based auth or
            if the server uses keyboard-interactive with a different password.

    config SSH_AUTO_RECONNECT
        bool "Automatically reconnect on SSH session drop"
        default n
        help
            When enabled, the main task transitions back to SSH_CONNECT after
            a session ends or drops.  When disabled, it halts in STATE_ERROR
            so the disconnect is visible and must be reset manually.

    config CYBERDECK_TZ
        string "POSIX timezone for the on-screen clock"
        default "UTC0"
        help
            POSIX TZ string applied at boot; the clock shows local time
            once NTP syncs (fetched once at first WiFi link-up).
            Examples: "UTC0", "MSK-3", "CET-1CEST,M3.5.0,M10.5.0/3",
            "EST5EDT,M3.2.0,M11.1.0".

    config CYBERDECK_NTP_SERVER
        string "NTP server for the on-screen clock"
        default "pool.ntp.org"
        help
            Hostname queried once (UDP port 123) after the first WiFi
            link-up. Point at a local server on isolated networks.

    config SSH_RECV_WINDOW
        int "SSH receive window size (bytes)"
        default 32768
        range 4096 262144
        help
            Advertised SSH channel receive window. The server will not send more
            than this many bytes before waiting for our acknowledgment.
            Smaller values reduce libssh2 heap (packet brigade) at the cost of
            more round-trips for bulk output. 32768 (32 KB) covers any terminal
            screen refresh.

    config SSH_WIFI_PS_NONE
        bool "Disable WiFi power-save while an SSH session is open"
        default y
        help
            The IDF default (WIFI_PS_MIN_MODEM) gates receive wakeups on the
            AP's DTIM beacon, adding tens of ms to every round-trip — that
            caps redraw throughput (TCP window / RTT) and delays each key
            echo. When enabled, the client switches to WIFI_PS_NONE for the
            lifetime of each SSH session and restores WIFI_PS_MIN_MODEM on
            disconnect. Costs radio power while a session is open. With the
            BLE keyboard connected, WiFi/BT coexistence still time-slices
            the radio, so the gain is real but smaller than on WiFi alone.

endmenu
```
